## Firmware/esp32_ad74416h/sdkconfig.defaults
```kconfig
# ESP-IDF SDK Configuration for BugBuster AD74416H Controller

# Console: NONE - we handle USB CDC ourselves via TinyUSB
# CONFIG_ESP_CONSOLE_USB_SERIAL_JTAG is not set
# CONFIG_ESP_CONSOLE_USB_CDC is not set
CONFIG_ESP_CONSOLE_NONE=y
CONFIG_ESP_CONSOLE_SECONDARY_NONE=y

# TinyUSB: triple CDC (CLI + 2x UART bridge)
CONFIG_TINYUSB=y
CONFIG_TINYUSB_CDC_ENABLED=y
CONFIG_TINYUSB_CDC_COUNT=3

# SPIFFS support
CONFIG_SPIFFS_MAX_PARTITIONS=3

# FreeRTOS
CONFIG_FREERTOS_HZ=1000

# Partition table
CONFIG_PARTITION_TABLE_CUSTOM=y
CONFIG_PARTITION_TABLE_CUSTOM_FILENAME="partitions.csv"

# Log level
CONFIG_LOG_DEFAULT_LEVEL_INFO=y

# SPI flash
CONFIG_ESPTOOLPY_FLASHSIZE_4MB=y
```
